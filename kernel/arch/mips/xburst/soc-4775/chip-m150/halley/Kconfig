## kernel/arch/mips/xburst/soc-4775/chip-m150/halley/Kconfig
```kconfig
choice
prompt "BOARD version"
depends on PRODUCT_HALLEY
default BOARD_HALLEY_V10

config BOARD_HALLEY_V10
bool "board halley v10"
depends on PRODUCT_HALLEY

endchoice

config BOARD_NAME
string
default "halley_v10" if BOARD_HALLEY_V10
```

## kernel/arch/mips/xburst/soc-m200/board/newton/Kconfig
```kconfig
choice
	prompt "BOARD type"
	depends on BOARD_NEWTON
	default BOARD_NEWTON_V20


config BOARD_NEWTON_V20
       bool "board newton v20"
       depends on BOARD_NEWTON

endchoice

config BOARD_NAME
	string
	default "newton_v20" if BOARD_NEWTON_V20
```

## kernel/arch/mips/xburst/soc-t10/chip-t10/isvp/Kconfig
```kconfig
choice
	prompt "Board type"
	depends on PLATFORM_ISVP
	default BOARD_MANGO

config BOARD_MANGO
       bool "Mango"
       depends on PLATFORM_ISVP

endchoice

config BOARD_NAME
	string
	default "mango" if BOARD_MANGO
```

## kernel/arch/mips/xburst/soc-t10/chip-t10/musca/Kconfig
```kconfig
choice
	prompt "Board type"
	depends on BOARD_MUSCA
	default BOARD_MUSCA_V10

config BOARD_MUSCA_V10
       bool "Musca V10"
       depends on BOARD_MUSCA

endchoice

config BOARD_NAME
	string
	default "musca_v10" if BOARD_MUSCA_V10
```

## kernel/arch/mips/xburst/soc-t15/Kconfig
```kconfig
choice
	prompt "Chip type"
	depends on SOC_T15
	default CHIP_T15

config CHIP_T15
       bool "chip-t15"
       select TRACEPOINTS
       select SYS_SUPPORTS_HIGHMEM
       select GENERIC_CLOCKEVENTS_BROADCAST

endchoice

if CHIP_T15
source "arch/mips/xburst/soc-t15/chip-t15/Kconfig"
endif
```

## kernel/arch/mips/xburst/soc-t15/chip-t15/bootes/Kconfig
```kconfig
choice
	prompt "Board type"
	depends on BOARD_BOOTES
	default BOARD_BOOTES_V10

config BOARD_BOOTES_V10
       bool "Bootes V10"
       depends on BOARD_BOOTES

endchoice

config BOARD_NAME
	string
	default "bootes_v10" if BOARD_BOOTES_V10
```

## kernel/arch/mips/xburst/soc-t15/chip-t15/fpga/Kconfig
```kconfig
choice
	prompt "Board type"
	depends on BOARD_FPGA_T15
	default BOARD_FPGA_T15_BASE

config BOARD_FPGA_T15_BASE
       bool "board fpga t15 base"
       depends on BOARD_FPGA_T15

endchoice

config BOARD_NAME
	string
	default "fpga_t15_base" if BOARD_FPGA_T15_BASE
```

## kernel/arch/mips/xburst/soc-t15/chip-t15/hercules/Kconfig
```kconfig
choice
	prompt "Board type"
	depends on BOARD_HERCULES
	default BOARD_HERCULES_V10

config BOARD_HERCULES_V10
       bool "Hercules V10"
       depends on BOARD_HERCULES

endchoice

config BOARD_NAME
	string
	default "hercules_v10" if BOARD_HERCULES_V10
```

## kernel/arch/mips/xburst/soc-t20/chip-t20/isvp/Kconfig
```kconfig
choice
	prompt "Board type"
	depends on PLATFORM_T20_ISVP
	default BOARD_BULL

config BOARD_BULL
       bool "bull"
       depends on PLATFORM_T20_ISVP

endchoice

config BOARD_NAME
	string
	default "bull" if BOARD_BULL
```

## kernel/drivers/media/platform/tx-isp/Kconfig
```kconfig
#
# tx-isp config states
#

config  SOC_MCLK
        bool 'MCLK from CPU'
        depends on VIDEO_TX_ISP
	default y
        ---help---
          MCLK from CPU.
```

## kernel/drivers/nand/driver/Kconfig
```kconfig
menuconfig NAND
	tristate "-------- nand driver ---------"

choice
        prompt "------------ soc select --------------"
        default NAND_JZ4780

config  NAND_JZ4780
        prompt "------------ 4780 soc --------------"
	help
		help mesage

config  NAND_JZ4790
        prompt "------------ 4790 soc --------------"
	help
		help mesage

endchoice
```

## kernel/drivers/net/wireless/mt7601u/Kconfig
```kconfig
config MT7601_STA
        tristate "MT7601_util STA support"
        default m
		select WIRELESS_EXT
		select WEXT_PRIV
#       depends on NET_RADIO
```

## kernel/drivers/usb/dwc2/Kconfig
```kconfig
config USB_JZ_DWC2
	tristate "DesignWare USB2 DRD Core Support"
	depends on USB_SUPPORT
	help
	  Say Y or M here if your system has a Dual Role SuperSpeed
	  USB controller based on the DesignWare USB2.0 IP Core.

	  If you choose to build this driver is a dynamically linked
	  module, the module will be called dwc2.ko.

if USB_JZ_DWC2

choice
	prompt "Driver Mode"
	help
	  Select Driver Mode

config USB_DWC2_DUAL_ROLE
	bool "Both Host and Device"
	depends on (USB && USB_GADGET)
	select USB_OTG
	help
	  Say Y here to enable both Host and Device function

config USB_DWC2_HOST_ONLY
	bool "Host Mode Only"
	depends on USB
	help
	  Say Y here to enable Host function only

config USB_DWC2_DEVICE_ONLY
	bool "Device Mode Only"
	depends on USB_GADGET
	select USB_OTG
	help
	  Say Y Here to enable Device function only

endchoice

config USB_DWC2_DRVVBUS_FUNCTION_PIN
       bool "Allow use dwc2 drvvbus function pin"
	depends on (USB_DWC2_HOST_ONLY || USB_DWC2_DUAL_ROLE)
	default n
	help
	 Say Y here to use dwc2 drvvbus pin

config USB_DWC2_ALLOW_WAKEUP
       bool "Allow wakeup when usb cable plug/unplug"
       depends on (USB_DWC2_DUAL_ROLE || USB_DWC2_DEVICE_ONLY)
       default y
       help
         Say Y here if you want usb cable plug/unplug to wakeup the system

config BOARD_HAS_NO_DETE_FACILITY
       bool "Board has no plug detect facility"
       default n
       help
         Say Y here if your board has no plug detect facility

config USB_DWC2_DEBUG
	bool "Enable Debugging(dev_dbg) Messages"
	help
	  Say Y here to enable debugging messages on DWC2 Driver.

config USB_DWC2_VERBOSE
	bool "Enable Verbose Debugging(dev_vdbg) Messages"
	depends on USB_DWC2_DEBUG
	help
	  Say Y here to enable verbose debugging messages on DWC2 Driver.

config USB_CHARGER_SOFTWARE_JUDGE
	bool "Enable software to judge connect to usb adapter or host"
	depends on (USB_DWC2_DUAL_ROLE || USB_DWC2_DEVICE_ONLY)
	default n
	help
		Say Y here if you want increase usb charger current limit,
		when connect to adapter

config USB_DWC2_VERBOSE_VERBOSE
	bool "Enable Very Verbose Debugging Messagers"
	default y
	help
	  enable debugging messages for developer debug, these debugging messages
          are switchable write 1 to file under /sys/module/dwc2/parameters/,
          the default value is 0, so you can always say Y here and won't get boring.

config USB_DWC2_HOST_TRACER
	bool "Enable tracing host operation flow"
	depends on (USB_DWC2_DUAL_ROLE || USB_DWC2_HOST_ONLY)
	help
	  Say Y here to enable tracing host operation flow,
	  you must reserve 192M~256M memory

config USB_DWC2_INPUT_EVDEV
       bool "Enable host mode device wakeup"
       depends on (USB_DWC2_DUAL_ROLE || USB_DWC2_HOST_ONLY)
       help
         Say Y here to enable host device insert to wakeup screen

config USB_DWC2_SAVING_POWER
       bool "Disable clock and power off controller when usb cable unplug"
       depends on USB_DWC2_DEVICE_ONLY || (USB_DWC2_DUAL_ROLE && !USB_DWC2_DRVVBUS_FUNCTION_PIN)
       default y
       help
         Say Y here to disable clock gate when usb cable unplug.
	 Currently only support Device Mode and OTG Mode , but this does not means
	 that we do not support Host Mode. Especially when OTG Mode ,
	 Note : 1, we can not support drvvbus function pin, because , insert otg may bring some jitter
	 our controler will have an session end interrupt.
		2, if we don not have detect pin or id pin clock and phy always keep on except suspend
endif
```

## kernel/drivers/video/soc_vpu/Kconfig
```kconfig
#
# soc_vpu configuration
#
config SOC_VPU
bool "soc vpu driver"
depends on !JZ_VPU_V12
default n
config CHANNEL_NODE_NUM
depends on SOC_VPU
int "channel node number"
default 4

config VPU_NODE_NUM
depends on SOC_VPU
int "vpu node number"
default 1

config JZ_NVPU
bool "client device of soc_vpu"
depends on SOC_VPU
default y
```
